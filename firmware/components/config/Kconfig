## firmware/components/config/Kconfig
```kconfig
menu "Node runtime config (events + sampling)"

config NODE_SAMPLING_RATE_MS
    int "Sampling period (ms)"
    default 50
    help
        Periodo iniziale del task di sensing. Aggiornabile a caldo via MQTT
        (chiave "sampling_rate" su desk/<id>/config).

config NODE_NOISE_THR_MILLI
    int "Noise threshold x1000 (0..1000)"
    default 600
    range 0 1000
    help
        Soglia rumore relativo moltiplicata per 1000 (Kconfig non ha float):
        600 = 0.6. Media finestra sopra soglia -> evento "high noise".
        Aggiornabile a caldo via MQTT (chiave "noise_thr", es. 0.3).

config NODE_LIGHT_THR
    int "Poor-light threshold (lux)"
    default 200
    help
        Media luce di finestra sotto questa soglia -> evento "poor lighting".
        Aggiornabile a caldo via MQTT (chiave "light_thr").

config NODE_OCCUPANCY_TIMEOUT_S
    int "Occupancy release timeout (s)"
    default 300
    help
        Secondi di inattivita' (nessuna occupazione di maggioranza) prima
        dell'evento "desk released". Aggiornabile via MQTT ("occupancy_timeout").

endmenu
```

## firmware/components/net/Kconfig
```kconfig
menu "Network (WiFi + telemetry)"

config WIFI_SSID
    string "WiFi SSID"
    default "Wokwi-GUEST"
    help
        SSID della rete WiFi. In Wokwi usare "Wokwi-GUEST" (rete aperta).

config WIFI_PASSWORD
    string "WiFi password"
    default ""
    help
        Password WiFi. Vuota per reti aperte (es. Wokwi-GUEST).

config DESK_ID
    string "Desk ID"
    default "desk-01"
    help
        Identificativo del nodo, usato come tag desk_id nella telemetria.

config PROXY_TELEMETRY_URL
    string "URL endpoint telemetria del proxy"
    default "http://CHANGE-ME.ngrok-free.dev/telemetry"
    help
        URL completo del POST telemetria. In Wokwi (public gateway, gratis) si
        raggiungono solo host PUBBLICI: esporre il proxy locale con un tunnel
        (ngrok http 8080) e mettere qui quell'URL http. Aggiornarlo ogni volta
        che il tunnel cambia. Su hardware reale in LAN: http://<ip>:8080/telemetry.

choice COMM_MODE_DEFAULT
    prompt "Trasporto telemetria di default"
    default COMM_MODE_DEFAULT_COAP
    help
        Trasporto usato all'avvio. Commutabile a runtime con
        net_set_communication_mode() (fase 05: aggiornabile da remoto via MQTT).

config COMM_MODE_DEFAULT_HTTP
    bool "HTTP"
config COMM_MODE_DEFAULT_COAP
    bool "CoAP"
endchoice

config COAP_SERVER_URI
    string "CoAP server URI"
    default "coap://93.49.108.145:5683/telemetry"
    help
        URI del server CoAP del proxy (aiocoap). Es. coap://<host>:5683/telemetry.
        NB: in Wokwi il Public Gateway raggiunge solo host pubblici e i tunnel free
        (ngrok/cloudflared) NON inoltrano UDP -> CoAP funziona su hardware reale in
        LAN (coap://<ip>:5683/telemetry) o con un gateway/tunnel UDP a pagamento.

config MQTT_BROKER_URI
    string "MQTT broker URI"
    default "mqtt://10.69.69.50:1883"
    help
        Broker mosquitto della fase 00 (TCP plain). Formato mqtt://host:1883.
        Il nodo pubblica gli eventi su desk/<id>/event e si sottoscrive a
        desk/<id>/config. In Wokwi serve un host pubblico o un tunnel TCP
        (es. ngrok tcp 1883): il public gateway non raggiunge la LAN. Su
        hardware reale in LAN: mqtt://<ip>:1883.

endmenu
```

## firmware/components/sensors/Kconfig
```kconfig
  menu "Sensors"

  choice SENSOR_BACKEND
      prompt "Sensor backend"
      default SENSOR_BACKEND_SIM

  config SENSOR_BACKEND_SIM
      bool "Simulazione (Wokwi: LDR/pot/pulsante)"

  config SENSOR_BACKEND_HW
      bool "Hardware reale (BH1750/MAX9814/PIR)"

  endchoice

  endmenu
```

## firmware/sdkconfig.defaults
```kconfig
# Default di progetto. Le fasi successive aggiungono opzioni (WiFi, MQTT, runtime stats...).
CONFIG_FREERTOS_HZ=1000

# Fase 05: HTTP + CoAP (libcoap) + MQTT insieme sforano la partizione single-app
# standard (~1MB, fase 04 era gia' al ~98%). Partizione app piu' grande.
CONFIG_PARTITION_TABLE_SINGLE_APP_LARGE=y

# Fase 08: necessari per la stima CPU-load via runtime stats (abilitare quando serve).
# CONFIG_FREERTOS_GENERATE_RUN_TIME_STATS=y
# CONFIG_FREERTOS_USE_TRACE_FACILITY=y
# CONFIG_FREERTOS_USE_STATS_FORMATTING_FUNCTIONS=y

CONFIG_PROXY_TELEMETRY_URL="http://vixen-ascension-showgirl.ngrok-free.dev/telemetry"
CONFIG_COMM_MODE_DEFAULT_COAP=n
CONFIG_COAP_SERVER_URI="coap://93.49.108.145:5683/telemetry"
CONFIG_MQTT_BROKER_URI="mqtt://10.69.69.50:1883"
```
